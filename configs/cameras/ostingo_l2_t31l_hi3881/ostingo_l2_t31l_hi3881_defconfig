## configs/cameras/ostingo_l2_t31l_hi3881/ostingo_l2_t31l_hi3881_defconfig
```kconfig
# NAME: Ostingo L2 / VicoHome CG721 (T31L, GC2063, HI3881)
# FRAG: soc-xburst1 core
BR2_AVPU_VPLL=y
BR2_INGENIC_SOC_MODEL="t31l"
BR2_SENSOR_1_NAME="gc2063"
BR2_PACKAGE_THINGINO_KOPT_MMC0=y
BR2_PACKAGE_THINGINO_KOPT_MMC0_PB_4BIT=y
BR2_PACKAGE_THINGINO_KOPT_MMC1=y
BR2_PACKAGE_THINGINO_KOPT_MMC1_PB_4BIT=y
BR2_PACKAGE_WIFI=y
# BR2_PACKAGE_WIFI_HI3881 is not set
BR2_PACKAGE_WIFI_HICHANNEL=y
BR2_TARGET_UBOOT_BOARDNAME="isvp_t31l_sfcnor"
BR2_TARGET_UBOOT_FORMAT_CUSTOM_NAME="u-boot-with-tpl-lzma.bin"
BR2_THINGINO_AUDIO=y
BR2_THINGINO_SDCARD=y
FLASH_SIZE_MB=16
```

## package/wifi-hichannel/Config.in
```kconfig
config BR2_PACKAGE_WIFI_HICHANNEL
	bool "HiSilicon hichannel (Hi3861L, self-boot SDIO)"
	select BR2_LINUX_KERNEL
	select BR2_PACKAGE_THINGINO_KOPT_MMC
	help
	  Ingenic T31 port of the LuckfoxTECH hichannel/hcc driver for the
	  HiSilicon Hi3861L over SDIO (MSC1).  The chip self-boots its own
	  firmware (SPC021) from internal flash, so no host firmware download
	  is performed (unlike the wifi-hi3881 driver).

	  Requires the jzmmc host fixes in all-patches/linux/3.10.14
	  (0099 drop CMD53 CRC retry, 0100 ignore stale error irq,
	  0101 mask stale data errors for CMD52) and pull-ups on the
	  SDIO CMD/DAT0 pins (package/wifi/files/mmc_gpio_pb).

	  Also installs /usr/bin/hinl.  The chip associates and runs DHCP
	  itself; S38wpa_supplicant calls "hinl up" with the credentials
	  from /etc/wpa_supplicant.conf, and hinl copies the chip's MAC and
	  address to wlan0.  There is no AP or portal mode: set credentials
	  with "wlan configure <ssid> <password>".

	  Do not enable together with BR2_PACKAGE_WIFI_HI3881 - both drivers
	  claim the same SDIO WiFi device.
```
